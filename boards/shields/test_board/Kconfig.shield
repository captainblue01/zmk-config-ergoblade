## config/boards/shields/ErgoBlade/Kconfig.defconfig
```kconfig
if SHIELD_ERGOBLADE
            
config ZMK_KEYBOARD_NAME
    default "ErgoBlade1"

endif
```

## config/boards/shields/ErgoBladeTest/Kconfig.defconfig
```kconfig
if SHIELD_ERGOBLADETEST
            
config ZMK_KEYBOARD_NAME
    default "ErgoBladeTest"

endif
```

## config/boards/shields/ErgoBladeTest/Kconfig.shield
```kconfig
config SHIELD_ERGOBLADETEST
    def_bool $(shields_list_contains,ErgoBladeTest)
    
```

## config/boards/shields/TubeTest/Kconfig.defconfig
```kconfig
if SHIELD_ERGOBLADE
            
config ZMK_KEYBOARD_NAME
    default "ErgoBlade"

endif
```
